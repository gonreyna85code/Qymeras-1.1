## components/qymera/Kconfig
```kconfig
menu "Qymera runtime"

config QYMERA_LOOP_STACK_SIZE
    int "Main loop task stack size (bytes)"
    default 8192
    help
        Stack budget for the Qymera core loop task. HTTP parsing, rule
        evaluation and JSON building all run here.

config QYMERA_WEB_PORT
    int "HTTP web server port"
    default 80

config QYMERA_REPORT_INTERVAL_DEFAULT_MS
    int "Default report interval (ms)"
    default 5000

endmenu
```

## main/Kconfig.projbuild
```kconfig
menu "Qymera example application"

config QYMERA_MATTER_ENABLE
    bool "Build the Matter bridge (ESP-Matter SDK required)"
    default n
    help
        Exposes Qymera relays as Matter OnOff endpoints and dimmers as
        LevelControl endpoints. Requires the espressif/esp_matter dependency
        declared in main/idf_component.yml. Keep disabled for a plain Qymera
        build.

endmenu
```
